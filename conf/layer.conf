## conf/layer.conf
```bitbake
# We have a conf and classes directory, append to BBPATH
BBPATH .= ":${LAYERDIR}"

# We have a recipes directory, add to BBFILES
BBFILES += "${LAYERDIR}/recipes*/*/*.bb ${LAYERDIR}/recipes*/*/*.bbappend"

BBFILE_COLLECTIONS += "evm"
BBFILE_PATTERN_evm := "^${LAYERDIR}/"
BBFILE_PRIORITY_evm = "20"
LAYERVERSION_evm = "4"
LAYERSERIES_COMPAT_evm = "scarthgap"
```
